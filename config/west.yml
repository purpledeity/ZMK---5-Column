## config/west.yml
```yaml
manifest:
  defaults:
    revision: v0.3
  remotes:
    - name: zmkfirmware
      url-base: https://github.com/zmkfirmware
    - name: petejohanson
      url-base: https://github.com/petejohanson
  projects:
    - name: zmk
      remote: zmkfirmware
      revision: v0.3
      import: app/west.yml
    - name: petejohansonScrollWheel
      remote: petejohanson
      revision: feat/pointers-move-scroll
      path: modules/petejohansonScrollWheel
  self:
    path: config
```
